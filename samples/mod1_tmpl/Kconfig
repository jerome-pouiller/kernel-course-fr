## samples/mod1_tmpl/Kconfig
```kconfig
config MY_CONFIG_OPTION
        tristate "my_module: A small Hello World sample"
        help
          Pedagogic purpose only.

          To compile it as a module, choose M here.  If unsure, say N.
```
